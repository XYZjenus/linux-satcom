## drivers/satdevctrl/hym8563/Kconfig
```kconfig
#
# I2C controler drivers satellite device
#

menuconfig SATDEV_CTRL 
	bool "satellite device controler"

if SATDEV_CTRL

config SATDEV_CLK_WIFI
	tristate "RTC HYM8563 clock out for WIFI 6335"
	depends on I2C
	default m
	help
	  If you say yes here you get support for hym8563 clk.	  
endif
```
